/**
 * @cliArgs --board "/TMDSCNCD280039C" --context "system" --product "C2000WARE@5.00.00.00"
 * @versions {"tool":"1.18.0+3266"}
 */

/**
 * Import the modules used in this configuration.
 */
const clb   = scripting.addModule("/driverlib/clb.js", {}, false);
const clb1  = clb.addInstance();
const clb2  = clb.addInstance();
const epwm  = scripting.addModule("/driverlib/epwm.js", {}, false);
const epwm1 = epwm.addInstance();
const epwm2 = epwm.addInstance();
const TILE  = scripting.addModule("/utilities/clb_tool/clb_syscfg/source/TILE", {}, false);
const TILE1 = TILE.addInstance();
const TILE2 = TILE.addInstance();

/**
 * Write custom configuration values to the imported modules.
 */
clb1.enableCLB                   = true;
clb1.attachTile                  = true;
clb1.inputTypeCLB_IN0            = "GLOBAL";
clb1.initTile                    = true;
clb1.$name                       = "CLB_SR";
clb1.outputsToOverridePeripheral = ["CLB_OUT4","CLB_OUT5"];
clb1.inputTypeCLB_IN1            = "GLOBAL";
clb1.filterConfigCLB_IN1         = "CLB_FILTER_RISING_EDGE";
clb1.inputTypeCLB_IN2            = "GLOBAL";
clb1.inputTypeCLB_IN3            = "GLOBAL";
clb1.filterConfigCLB_IN3         = "CLB_FILTER_RISING_EDGE";
clb1.clbBase                     = "CLB2_BASE";
clb1.globalConfigCLB_IN2         = "CLB_GLOBAL_IN_MUX_EPWM1B";
clb1.globalConfigCLB_IN3         = "CLB_GLOBAL_IN_MUX_EPWM1B";
clb1.filterConfigCLB_IN0         = "CLB_FILTER_FALLING_EDGE";
clb1.filterConfigCLB_IN2         = "CLB_FILTER_FALLING_EDGE";
clb1.inputsUsed                  = ["CLB_IN0","CLB_IN1","CLB_IN2","CLB_IN3","CLB_IN4","CLB_IN5"];
clb1.inputTypeCLB_IN5            = "LOCAL";
clb1.synchronizeCLB_IN5          = true;
clb1.localConfigCLB_IN5          = "CLB_LOCAL_IN_MUX_EPWM_DCAH";
clb1.synchronizeCLB_IN0          = true;
clb1.synchronizeCLB_IN1          = true;
clb1.synchronizeCLB_IN2          = true;
clb1.synchronizeCLB_IN3          = true;

clb2.$name                       = "CLB_SYN";
clb2.enableCLB                   = true;
clb2.inputTypeCLB_IN0            = "GLOBAL";
clb2.globalConfigCLB_IN0         = "CLB_GLOBAL_IN_MUX_EPWM1A_AQ";
clb2.inputTypeCLB_IN1            = "GLOBAL";
clb2.attachTile                  = true;
clb2.initTile                    = true;
clb2.outputsToOverridePeripheral = ["CLB_OUT5"];
clb2.globalConfigCLB_IN1         = "CLB_GLOBAL_IN_MUX_EPWM1A_AQ";
clb2.filterConfigCLB_IN1         = "CLB_FILTER_RISING_EDGE";
clb2.inputTypeCLB_IN2            = "GLOBAL";
clb2.filterConfigCLB_IN2         = "CLB_FILTER_FALLING_EDGE";
clb2.inputTypeCLB_IN3            = "GLOBAL";
clb2.globalConfigCLB_IN3         = "CLB_GLOBAL_IN_MUX_EPWM1B_DB";
clb2.filterConfigCLB_IN3         = "CLB_FILTER_FALLING_EDGE";
clb2.gpStartValueConfigCLB_IN4   = 1;
clb2.globalConfigCLB_IN2         = "CLB_GLOBAL_IN_MUX_EPWM1A_AQ";
clb2.inputTypeCLB_IN5            = "GLOBAL";
clb2.globalConfigCLB_IN5         = "CLB_GLOBAL_IN_MUX_EPWM1A_DB";
clb2.inputsUsed                  = ["CLB_IN0","CLB_IN1","CLB_IN2","CLB_IN3","CLB_IN4"];
clb2.inputPipelineConfigCLB_IN0  = true;
clb2.inputPipelineConfigCLB_IN1  = true;
clb2.inputPipelineConfigCLB_IN2  = true;
clb2.inputPipelineConfigCLB_IN3  = true;

epwm1.$hardware                                                     = system.deviceData.board.components.PWM_LOC1;
epwm1.$name                                                         = "EPWM1_BASE";
epwm1.epwmMemoryFileBrowse                                          = "../../../../../ti/ccs1250/ccs/eclipse/capstone_EPWM_configuration.dat";
epwm1.epwmTimebase_counterMode                                      = "EPWM_COUNTER_MODE_UP_DOWN";
epwm1.epwmTimebase_hsClockDiv                                       = "EPWM_HSCLOCK_DIVIDER_1";
epwm1.epwmTimebase_syncOutPulseMode                                 = ["EPWM_SYNC_OUT_PULSE_ON_CNTR_ZERO","EPWM_SYNC_OUT_PULSE_ON_SOFTWARE"];
epwm1.epwmDeadband_enableRED                                        = true;
epwm1.epwmDeadband_enableFED                                        = true;
epwm1.epwmDeadband_redShadowMode                                    = true;
epwm1.epwmDeadband_fedShadowMode                                    = true;
epwm1.epwmGlobalLoad_gld                                            = true;
epwm1.epwmGlobalLoad_enableOneShot                                  = true;
epwm1.epwmCounterCompare_cmpAGld                                    = true;
epwm1.epwmCounterCompare_cmpBGld                                    = true;
epwm1.epwmCounterCompare_cmpCGld                                    = true;
epwm1.epwmCounterCompare_cmpDGld                                    = true;
epwm1.epwmDeadband_redGld                                           = true;
epwm1.epwmDeadband_fedGld                                           = true;
epwm1.epwmActionQualifier_continousSwForceReloadModeGld             = true;
epwm1.epwmActionQualifier_EPWM_AQ_OUTPUT_A_ON_TIMEBASE_UP_CMPA      = "EPWM_AQ_OUTPUT_HIGH";
epwm1.epwmActionQualifier_EPWM_AQ_OUTPUT_B_ON_TIMEBASE_DOWN_CMPB    = "EPWM_AQ_OUTPUT_LOW";
epwm1.epwmDeadband_delayRED                                         = 50;
epwm1.epwmDeadband_delayFED                                         = 50;
epwm1.epwmTimebase_phaseShift                                       = 2;
epwm1.epwmCounterCompare_cmpA                                       = 1;
epwm1.epwmCounterCompare_cmpB                                       = 488;
epwm1.epwmTripZone_cbcSource                                        = ["EPWM_TZ_SIGNAL_CBC6"];
epwm1.epwmTripZone_oneShotSource                                    = ["EPWM_TZ_SIGNAL_DCAEVT1"];
epwm1.epwmDigitalCompare_EPWM_TZ_DC_OUTPUT_A1                       = "EPWM_TZ_EVENT_DCXH_HIGH";
epwm1.epwmTripZone_EPWM_TZ_ACTION_EVENT_TZA                         = "EPWM_TZ_ACTION_LOW";
epwm1.epwmTripZone_EPWM_TZ_ACTION_EVENT_TZB                         = "EPWM_TZ_ACTION_LOW";
epwm1.epwmTripZone_EPWM_TZ_ACTION_EVENT_DCAEVT1                     = "EPWM_TZ_ACTION_DISABLE";
epwm1.epwmTripZone_EPWM_TZ_ACTION_EVENT_DCAEVT2                     = "EPWM_TZ_ACTION_DISABLE";
epwm1.epwmTripZone_EPWM_TZ_ACTION_EVENT_DCBEVT1                     = "EPWM_TZ_ACTION_DISABLE";
epwm1.epwmTripZone_EPWM_TZ_ACTION_EVENT_DCBEVT2                     = "EPWM_TZ_ACTION_DISABLE";
epwm1.epwmDigitalCompare_EPWM_DC_TYPE_DCAH                          = "EPWM_DC_TRIP_COMBINATION";
epwm1.epwmDigitalCompare_EPWM_DC_MODULE_A_EPWM_DC_EVENT_1_eventSync = "EPWM_DC_EVENT_INPUT_NOT_SYNCED";
epwm1.epwmDigitalCompare_EPWM_DC_TYPE_DCAH_combinationInputConfig   = ["EPWM_DC_COMBINATIONAL_TRIPIN4","EPWM_DC_COMBINATIONAL_TRIPIN5"];
epwm1.epwmActionQualifier_EPWM_AQ_OUTPUT_A_shadowMode               = true;
epwm1.epwmActionQualifier_EPWM_AQ_OUTPUT_B_shadowMode               = true;
epwm1.epwmGlobalLoad_oneShotMode                                    = true;
epwm1.hrpwm_edgeModeA                                               = "HRPWM_MEP_CTRL_RISING_AND_FALLING_EDGE";
epwm1.hrpwm_edgeModeB                                               = "HRPWM_MEP_CTRL_RISING_AND_FALLING_EDGE";
epwm1.hrpwm_HRLoadA                                                 = "HRPWM_LOAD_ON_CNTR_ZERO_PERIOD";
epwm1.hrpwm_HRLoadB                                                 = "HRPWM_LOAD_ON_CNTR_ZERO_PERIOD";
epwm1.epwmCounterCompare_shadowLoadModeCMPA                         = "EPWM_COMP_LOAD_ON_CNTR_ZERO_PERIOD";
epwm1.epwmCounterCompare_shadowLoadModeCMPB                         = "EPWM_COMP_LOAD_ON_CNTR_ZERO_PERIOD";
epwm1.epwmDeadband_polarityFED                                      = "EPWM_DB_POLARITY_ACTIVE_LOW";
epwm1.epwmActionQualifier_EPWM_AQ_OUTPUT_B_ON_TIMEBASE_ZERO         = "EPWM_AQ_OUTPUT_HIGH";
epwm1.epwmActionQualifier_EPWM_AQ_OUTPUT_B_ON_TIMEBASE_PERIOD       = "EPWM_AQ_OUTPUT_HIGH";
epwm1.epwmActionQualifier_EPWM_AQ_OUTPUT_A_ON_TIMEBASE_PERIOD       = "EPWM_AQ_OUTPUT_LOW";
epwm1.epwmActionQualifier_EPWM_AQ_OUTPUT_A_ON_TIMEBASE_ZERO         = "EPWM_AQ_OUTPUT_LOW";
epwm1.hrpwm_cmpaHR                                                  = 128;
epwm1.hrpwm_cmpbHR                                                  = 5;
epwm1.hrpwm_tbprdHR                                                 = 255;
epwm1.epwmDeadband_deadbandCounterClockRate                         = "EPWM_DB_COUNTER_CLOCK_HALF_CYCLE";
epwm1.hrpwm_DBredHR                                                 = 50;
epwm1.hrpwm_DBfedHR                                                 = 50;
epwm1.hrpwm_edgeModeDB                                              = "HRPWM_DB_MEP_CTRL_RED_FED";
epwm1.epwmTimebase_periodGld                                        = true;
epwm1.epwmTimebase_period                                           = 59;
epwm1.hrpwm_enable                                                  = true;
epwm1.hrpwm_periodEnable                                            = true;
epwm1.hrpwm_autoConv                                                = true;

epwm2.$name                                = "EPWM3_BASE";
epwm2.$hardware                            = system.deviceData.board.components.PWM_LOC3;
epwm2.epwmMemoryFileBrowse                 = "../../../../../ti/ccs1250/ccs/eclipse/capstone_EPWM3_configuration.dat";
epwm2.epwmTimebase_counterMode             = "EPWM_COUNTER_MODE_UP_DOWN";
epwm2.epwmTimebase_periodLoadMode          = "EPWM_PERIOD_DIRECT_LOAD";
epwm2.epwmTimebase_hsClockDiv              = "EPWM_HSCLOCK_DIVIDER_1";
epwm2.epwmTimebase_counterValue            = 665;
epwm2.epwmTimebase_period                  = 1200;
epwm2.epwmEventTrigger_interruptSource     = "EPWM_INT_TBCTR_ZERO";
epwm2.epwmEventTrigger_enableInterrupt     = true;
epwm2.epwmEventTrigger_interruptEventCount = "1";

TILE1.$name                  = "TILE0";
clb1.tile                    = TILE1;
TILE1.BOUNDARY.$name         = "BOUNDARY0";
TILE1.LUT_0.$name            = "LUT_0";
TILE1.LUT_0.eqn              = "i0|i1";
TILE1.LUT_0.i0               = "BOUNDARY.in0";
TILE1.LUT_0.i1               = "COUNTER_0.count_match1";
TILE1.LUT_1.$name            = "LUT_1";
TILE1.LUT_1.eqn              = "i0|i1";
TILE1.LUT_1.i0               = "BOUNDARY.in2";
TILE1.LUT_1.i1               = "COUNTER_1.count_match1";
TILE1.LUT_2.$name            = "LUT_2";
TILE1.LUT_2.i1               = "BOUNDARY.in4";
TILE1.LUT_2.eqn              = "i0&i1";
TILE1.LUT_2.i0               = "BOUNDARY.in1";
TILE1.FSM_0.$name            = "FSM_0";
TILE1.FSM_0.e0               = "BOUNDARY.in1";
TILE1.FSM_0.eqn_s0           = "(~s0&e0)|(s0&~e1)";
TILE1.FSM_0.e1               = "LUT_0.OUT";
TILE1.FSM_1.$name            = "FSM_1";
TILE1.FSM_1.e0               = "BOUNDARY.in3";
TILE1.FSM_1.eqn_s0           = "(s0&~e0)|(~s0&e1)";
TILE1.FSM_1.e1               = "LUT_1.OUT";
TILE1.FSM_2.$name            = "FSM_2";
TILE1.COUNTER_0.$name        = "COUNTER_0";
TILE1.COUNTER_0.reset        = "BOUNDARY.in1";
TILE1.COUNTER_0.mode0        = "1";
TILE1.COUNTER_0.mode1        = "1";
TILE1.COUNTER_0.match1_val   = "300";
TILE1.COUNTER_1.$name        = "COUNTER_1";
TILE1.COUNTER_1.reset        = "BOUNDARY.in3";
TILE1.COUNTER_1.mode0        = "1";
TILE1.COUNTER_1.mode1        = "1";
TILE1.COUNTER_1.match1_val   = "300";
TILE1.COUNTER_2.$name        = "COUNTER_2";
TILE1.OUTLUT_0.$name         = "OUTLUT_0";
TILE1.OUTLUT_1.$name         = "OUTLUT_1";
TILE1.OUTLUT_2.$name         = "OUTLUT_2";
TILE1.OUTLUT_3.$name         = "OUTLUT_3";
TILE1.OUTLUT_4.$name         = "OUTLUT_4";
TILE1.OUTLUT_4.i1            = "FSM_0.S0";
TILE1.OUTLUT_4.eqn           = "i0&i1";
TILE1.OUTLUT_4.i0            = "BOUNDARY.in4";
TILE1.OUTLUT_5.$name         = "OUTLUT_5";
TILE1.OUTLUT_5.i1            = "FSM_1.S0";
TILE1.OUTLUT_5.eqn           = "~i0 | i1";
TILE1.OUTLUT_5.i0            = "BOUNDARY.in5";
TILE1.OUTLUT_6.$name         = "OUTLUT_6";
TILE1.OUTLUT_7.$name         = "OUTLUT_7";
TILE1.HLC.$name              = "HLC_0";
TILE1.HLC.e0                 = "LUT_2.OUT";
TILE1.HLC.program0.$name     = "HLCP_0";
TILE1.HLC.program0.instruct0 = "MOV_T1 R0, C0";
TILE1.HLC.program0.instruct1 = "MOV_T1 R0, C1";
TILE1.HLC.program1.$name     = "HLCP_1";
TILE1.HLC.program2.$name     = "HLCP_2";
TILE1.HLC.program3.$name     = "HLCP_3";
TILE1.AOC_0.$name            = "AOC_0";
TILE1.AOC_1.$name            = "AOC_1";
TILE1.AOC_2.$name            = "AOC_2";
TILE1.AOC_3.$name            = "AOC_3";
TILE1.AOC_4.$name            = "AOC_4";
TILE1.AOC_5.$name            = "AOC_5";
TILE1.AOC_6.$name            = "AOC_6";
TILE1.AOC_7.$name            = "AOC_7";

TILE2.$name                  = "TILE1";
clb2.tile                    = TILE2;
TILE2.BOUNDARY.$name         = "BOUNDARY1";
TILE2.LUT_0.$name            = "LUT_3";
TILE2.LUT_1.$name            = "LUT_4";
TILE2.LUT_2.$name            = "LUT_5";
TILE2.FSM_0.$name            = "FSM_3";
TILE2.FSM_0.eqn_s0           = "(s0&~e0)|(~s0&e1)";
TILE2.FSM_0.e0               = "BOUNDARY.in2";
TILE2.FSM_0.e1               = "COUNTER_0.count_zero";
TILE2.FSM_1.$name            = "FSM_4";
TILE2.FSM_2.$name            = "FSM_5";
TILE2.COUNTER_0.$name        = "COUNTER_3";
TILE2.COUNTER_0.reset        = "BOUNDARY.in1";
TILE2.COUNTER_0.mode0        = "1";
TILE2.COUNTER_0.mode1        = "BOUNDARY.in0";
TILE2.COUNTER_1.$name        = "COUNTER_4";
TILE2.COUNTER_2.$name        = "COUNTER_5";
TILE2.OUTLUT_0.$name         = "OUTLUT_8";
TILE2.OUTLUT_1.$name         = "OUTLUT_9";
TILE2.OUTLUT_2.$name         = "OUTLUT_10";
TILE2.OUTLUT_3.$name         = "OUTLUT_11";
TILE2.OUTLUT_4.$name         = "OUTLUT_12";
TILE2.OUTLUT_4.eqn           = "i0";
TILE2.OUTLUT_4.i0            = "FSM_0.S0";
TILE2.OUTLUT_5.$name         = "OUTLUT_13";
TILE2.OUTLUT_5.i0            = "FSM_0.S0";
TILE2.OUTLUT_5.i1            = "BOUNDARY.in4";
TILE2.OUTLUT_5.eqn           = "i0 & i1";
TILE2.OUTLUT_6.$name         = "OUTLUT_14";
TILE2.OUTLUT_7.$name         = "OUTLUT_15";
TILE2.HLC.$name              = "HLC_1";
TILE2.HLC.e0                 = "BOUNDARY.in2";
TILE2.HLC.program0.$name     = "HLCP_4";
TILE2.HLC.program0.instruct0 = "MOV C0, R0";
TILE2.HLC.program1.$name     = "HLCP_5";
TILE2.HLC.program2.$name     = "HLCP_6";
TILE2.HLC.program3.$name     = "HLCP_7";
TILE2.AOC_0.$name            = "AOC_8";
TILE2.AOC_1.$name            = "AOC_9";
TILE2.AOC_2.$name            = "AOC_10";
TILE2.AOC_3.$name            = "AOC_11";
TILE2.AOC_4.$name            = "AOC_12";
TILE2.AOC_5.$name            = "AOC_13";
TILE2.AOC_6.$name            = "AOC_14";
TILE2.AOC_7.$name            = "AOC_15";

/**
 * Pinmux solution for unlocked pins/peripherals. This ensures that minor changes to the automatic solver in a future
 * version of the tool will not impact the pinmux you originally saw.  These lines can be completely deleted in order to
 * re-solve from scratch.
 */
epwm1.epwm.$suggestSolution           = "EPWM1";
epwm1.epwm.epwm_aPin.$suggestSolution = "hsecDigital.49";
epwm1.epwm.epwm_bPin.$suggestSolution = "hsecDigital.51";
epwm2.epwm.$suggestSolution           = "EPWM3";
epwm2.epwm.epwm_aPin.$suggestSolution = "hsecDigital.50";
epwm2.epwm.epwm_bPin.$suggestSolution = "hsecDigital.52";
